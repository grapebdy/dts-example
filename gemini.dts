/dts-v1/;
#include <config.h>
/ {
	#address-cells = <2>;
	#size-cells = <2>;
	pcie0: pcie@f8000000 {
		compatible = "gemini,gemini-pcie";
		reg = <0x0 PCIE_ADDR 0x0 0x2000000>,
		      <0x0 0xfd000000 0x0 0x1000000>;
		status = "disabled";
	};
};
